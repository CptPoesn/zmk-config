## config/west.yml
```yaml
manifest:
  remotes:
    - name: zmkfirmware
      url-base: https://github.com/zmkfirmware
    - name: cobowers
      url-base: https://github.com/cobowers
  projects:
    - name: zmk
      remote: cobowers
      revision: cobowers-mouse-ftc 
      import: app/west.yml
  self:
    path: config
```
